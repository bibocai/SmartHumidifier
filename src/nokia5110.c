#include "nokia5110.h"


uchar index[10]={0,1,2,3,4,5,6,7,8,9};
uchar str[10];
const char code characters[]={
		0x00, 0x3E, 0x51, 0x49, 0x45, 0x3E ,/*"0",0*/
		0x00, 0x00, 0x42, 0x7F, 0x40, 0x00 ,/*"1",1*/
		0x00, 0x42, 0x61, 0x51, 0x49, 0x46 ,/*"2",2*/
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		0xff, 0xff, 0xff, 0xff, 0xff, 0xff };/*12*/

		
const char code characters16_16[]= 
{
0x04,0x84,0xE4,0x5C,0x44,0xC4,0x20,0x10,0xE8,0x27,0x24,0xE4,0x34,0x2C,0xE0,0x00,
0x02,0x01,0x7F,0x10,0x10,0x3F,0x80,0x60,0x1F,0x09,0x09,0x3F,0x49,0x89,0x7F,0x00,/*"确",0*/
0x10,0x0C,0x44,0x44,0x44,0x44,0x45,0xC6,0x44,0x44,0x44,0x44,0x44,0x14,0x0C,0x00,
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0x04,0x04,0x02,0x0A,0x09,0x29,0x2A,0x4C,0x48,0xA9,0x19,0x02,0x02,0x04,0x04,0x00};/*"零",9*/

void lcdDC(uchar dt,uchar command)
{
	uchar i = 0;
	CE = 0;
	if(command == 0)
		DC = 0;
	else DC = 1;
	for(i;i<8;i++)
	{
		if(dt & 0x80)
			DIN = 1;
		else
			DIN = 0;
		CLK = 0;
		dt = dt << 1;
		CLK = 1;
	}
	CE = 1;
}
void lcdClear(void)
{
	uchar t = 0,k = 0;
	lcdDC(0x0C,0);
	lcdDC(0x80,0);
	for(t = 0;t < 6;t ++)
	{
		for(k = 0;k < 84;k ++)
		{
			lcdDC(0x00,1);
		}
	}
}
void Init5110(void)
{
	RST = 0;
	delay_ms(1);
	RST = 1;
	CE = 0;
	delay_ms(1);
	CE = 1;
	delay_ms(1);
	lcdDC(0x21,0);	
	lcdDC(0xB8,0);			
	lcdDC(0x06,0);	
  lcdDC(0x13,0);;
	lcdDC(0x20,0);
  lcdClear();
	lcdDC(0x0C,0);
	CE = 0;
	delay_ms(200);
}
void lcdSetXY(uchar X,uchar Y)
{
	lcdDC(0x40 | Y,0);
	lcdDC(0x80 | X,0);
}
void lcdWriteChar6_8(uchar row,uchar page,uchar character)	 //row : 0~13  page :0~5 
{
	uchar i = 0;
	lcdSetXY(row * 6,page);
	for(i = 0;i < 6; i ++)
	{
		lcdDC(characters[character * 6 + i],1);
	}
}

//write a character(6*8),don't need coordinates  
void lcdWriteChar(uchar value)  
{  
    uchar i;  
    for(i = 0;i < 6;i ++)  
			lcdDC(ASCII_6_8[value - 0x20][i],1);  
}  
//write a char(6*8),need coordinates  
void lcdPutChar(uchar value,uchar x,uchar y)  
{  
    if(x > 13) x = 0;  
    lcdSetXY(6 * x,y);  
    lcdWriteChar(value);  
}  
//write a string(6*8),don't need coordinates  
void lcdWriteStr(uchar * str)  
{  
    while(*str)  
    {  
        lcdWriteChar(*str ++);  
    }  
}  
//write a string(6*8),need coordinates,auto line breaks  
void lcdPutStr(uchar * str,uchar x,uchar y)  
{  
    if(x > 13) x = 0;  
    lcdSetXY(6 * x,y);  
    lcdWriteStr(str);  
}  

void lcdWriteChar16_16(uchar row,uchar page,uchar character)	 //row : 0~13  page :0~5 
{
	uchar i = 0;
	lcdSetXY(row * 16,page);
	for(i = 0;i < 16; i ++)
		lcdDC(characters16_16[character * 32 + i], 1);
	lcdSetXY(row * 16,page + 1);
	for(i = 16;i < 32; i ++)
		lcdDC(characters16_16[character * 32 + i], 1);
}
void lcdClearAny(uchar page,uchar Row_S,uchar Row_E)
{
	uchar i;
	lcdSetXY(6*Row_S,page);
	for(i=0;i<6*(Row_E-Row_S);i++)
		lcdDC(0x00,1);
}
void lcdShowDouble(uchar page,uchar row,double y,uchar n) //n为显示小数的位数
{
    uint a[10],b,multi;
	uchar i=0,j,f,flag=0,sign=0;
	double x=y;
	unsigned long int w;
	if(x<0) {x=-x,sign=0;}
	else sign=1;
	switch(n)
	{case 0:multi=1;break;
	case 1:multi=10;break;
	case 2:multi=100;break;
	case 3:multi=1000;break;}
	w=(unsigned long int)(x*multi);
	while(1)
	{
		b=w/10;
		i++;
		if(b==0)break;
		w=w/10;
	}
	w=(long int)(x*multi);
	if(w<1000&&n!=0) i=4;
	j=i;
	while(i)
	{
		a[i-1]=w%10;
		w=w/10;
		i--;
	}
	w=(long int)(x*multi);
	if(sign==0)lcdWriteChar6_8(row-1,page,11);
if(w!=0)
	while(i!=j)
	{
		if(flag==0)f=0;else f=1;
		lcdWriteChar6_8(row+i+f,page,a[i]);
		i++;
		if(n!=0)
		{if(i==j-n){flag=1;lcdWriteChar6_8(row+i,page,10);}}
	}
else {lcdClearAny(page,row,row+i);lcdWriteChar6_8(row+i,page,0);}
}


//write a Chinese character(16*16)  
void lcdWriteChinese(uchar Hanzi[],uchar x,uchar y)  
{  
    uchar i;  
    //write the first row  
    lcdSetXY(x,y * 2);  
    for(i = 0;i < 16;i ++)  
    lcdDC(Hanzi[i],1);  
    //write the second row  
    lcdSetXY(x,2 * y + 1);  
    for(i = 16;i < 32;i ++)  
        lcdDC(Hanzi[i],1);  
}  
//write a Chinese sentence(16*16),auto line breaks,x is between 0 and 58  
void lcdWriteChineseStr(uchar Hanzi[],uchar x,uchar y,uchar num)  
{  
    uchar num_i,i = 0;  
    for(num_i = 0;num_i < num;num_i ++)  
    {  
        //if need line breaks  
        if(x + (16 * num_i) > 58)  
        {  
            x = 0;  
            i = 0;  
            y += 1;  
        }  
        //write a Chinese character(16*16)  
        lcdWriteChinese(Hanzi + 32 * num_i,x + (16 * i),y);  
        i ++;  
    }  
}  